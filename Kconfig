## Kconfig
```kconfig
# SPDX-License-Identifier: GPL-3.0-or-later
#
# Generic SDK switches are sourced once here; board switches belong to this app.
source "packages/third-party/rt-carplay/Kconfig"

menu "rt-carplay application"

config RTCARPLAY_SINGLE_SCREEN_FUSION
    select LV_FONT_MONTSERRAT_12
    bool "Single-screen CarPlay and local vehicle instruments"
    default y if RTCARPLAY_DEMO_LAUNCHER
    depends on RTCARPLAY_DEMO_LAUNCHER
    help
      Application display modes FULLSCREEN/FUSION/LOCAL. Uses hardware DE
      video positioning and UI-layer cropping on the single D213 panel.
      Vehicle values default to explicitly labelled simulated data. This is
      a local integration demo, not Apple's Ultra Local UI renderer.

config RTCARPLAY_VEHICLE_PROTOCOL_DEMO
    bool "Experimental Vehicle State protocol bench (SIMULATED engine RPM)"
    default n
    help
      Attach a three-characteristic combustion-engine simulator to the real
      authenticated Vehicle State lanes. Advertises only this implemented
      model as rt-carplay SIMULATED, and enables vehicleStateProtocol only
      when the phone offers it. Supports config/read/register/notifications;
      phone writes are refused. This is not a real vehicle, road speed,
      battery SOC, official Local UI renderer or complete CarPlay Ultra.
      UI Sync, HEVC and alternate-display declarations remain disabled.
      The ordinary Classic profiles leave this development option disabled.

config RTCARPLAY_USB_FILE_SYNC
    bool "Development USB file transfer (CherryUSB ADB sync only)"
    default n
    depends on RT_USING_DFS && AIC_USING_USB0_DEVICE
    depends on LPKG_CHERRYUSB_DEVICE && LPKG_CHERRYUSB_DEVICE_CLASS_NULL
    depends on !LPKG_USING_ADBD
    help
      Reuse CherryUSB's ADB sync service and RT-Thread DFS adapter on USB0.
      USB1 remains the iPhone host port. Supports adb push/pull without a
      separate adbd package or shell service. Uses the upstream demo USB
      descriptors (FFFF:FFFF), for development only. Files are accessed via
      DFS; this does not export a concurrently mounted raw block device.

config CONFIG_LV_FONT_FMT_TXT_LARGE
    int
    depends on RTCARPLAY_DEMO_LAUNCHER
    default 1

config CONFIG_LV_USE_FONT_COMPRESSED
    int
    depends on RTCARPLAY_DEMO_LAUNCHER
    default 1

config RTCARPLAY_DEMO_LAUNCHER
    bool "Cockpit LVGL 9 launcher"
    select RTCARPLAY_AUTO_CONNECT
    select LV_FONT_MONTSERRAT_14
    select LV_FONT_MONTSERRAT_16
    select LV_FONT_MONTSERRAT_24
    select LV_FONT_MONTSERRAT_32
    default n
    depends on LPKG_USING_LVGL && LVGL_V_9 && RTCARPLAY_USB_HOST && RTCARPLAY_VIDEO
    depends on !RT_USING_MODULE && !LPKG_USING_LVGL_SQUARELINE
    help
      Display the automatic USB/wireless connection dashboard, pairing,
      devices, settings, audio tests and diagnostics. Application connection
      ownership is independent of the GUI. Phone consent remains required.
      Requires the SDK lv_user_gui_init hook. CarPlay owns panel input.

config RTCARPLAY_DEMO_DEVELOPER_OPTIONS
    bool "Show Cockpit developer options"
    default y
    depends on RTCARPLAY_DEMO_LAUNCHER

config RTCARPLAY_D213_BOARD_KEYS
    bool "D213ECV-DEMO V4.0 PA.6 function keys"
    default n
    depends on RTCARPLAY_DEMO_LAUNCHER && AIC_USING_GPAI6 && AIC_GPAI6_MODE_SINGLE
    help
      Read the four KEYADC buttons and queue Classic CarPlay controls.

config RTCARPLAY_AUTO_CONNECT
    bool "Automatic USB/wireless connection manager"
    default y if RTCARPLAY_DEMO_LAUNCHER
    depends on RTCARPLAY_USB_HOST
    help
      Arm USB discovery and start wireless discovery together at boot.
      A single application owner arbitrates sessions and performs bounded
      retry/backoff and resource retirement. May run without LVGL.
      Do not mix manual receiver/USB/iAP2 lifecycle commands with this owner.

config RTCARPLAY_INTERNET_SHARE
    bool "Ethernet to CarPlay AP IPv4 sharing (requires iPhone validation)"
    default n
    depends on RT_USING_LWIP212 && LWIP_USING_DHCPD && RT_LWIP_DHCP
    depends on !LWIP_NO_RX_THREAD
    depends on LPKG_RT_CARPLAY_LUBANLITE_WIFI && AIC_USING_GMAC0
    help
      Optional host-only Ethernet DHCP, bounded NAPT, upstream DNS routing and checked
      DHCP gateway/DNS offers. Does not change Apple vendor IE or iAP2.
      Requires an Ethernet-connected board and iPhone routing validation.
      CarPlay remains local when upstream detection fails. IPv4 only.

config RTCARPLAY_INTERNET_WAN
    string "Ethernet RT-Thread device name"
    default "e0"
    depends on RTCARPLAY_INTERNET_SHARE

config RTCARPLAY_INTERNET_PROBE_HOST
    string "HTTP 204 connectivity probe host"
    default "connectivitycheck.gstatic.com"
    depends on RTCARPLAY_INTERNET_SHARE
    help
      Choose a reachable endpoint in the deployment network. A failed or
      redirected probe closes sharing even if some other sites are reachable.

config RTCARPLAY_NETWORK_TIME
    bool "Network time synchronization in Date & time"
    default y
    depends on RTCARPLAY_DEMO_LAUNCHER && RT_USING_RTC
    depends on RT_USING_LWIP212 && RT_LWIP_DNS && RT_USING_DFS
    depends on RTCARPLAY_INTERNET_SHARE || RTCARPLAY_OTA

config RTCARPLAY_NTP_SERVER
    string "Default network time server"
    default "time.cloudflare.com"
    depends on RTCARPLAY_NETWORK_TIME

config RTCARPLAY_OTA
    bool "HTTP/HTTPS A/B OTA command and update settings"
    default y
    depends on LPKG_USING_OTA_DOWNLOADER && LPKG_USING_WEBCLIENT
    depends on AIC_AB_SYSTEM_INTERFACE
    depends on RTCARPLAY_AUTO_CONNECT && RT_USING_WIFI && RT_USING_RTC
    depends on RT_USING_DFS && RT_USING_LWIP && WEBCLIENT_USING_MBED_TLS
    depends on AIC_SPINAND_DRV && !OTA_RODATA_DIRECT
    help
      Stage and validate a D213 CarPlay .cpio from an HTTP or HTTPS URL.
      On confirmation the SDK OTA downloader updates inactive OS and Rodata slots.

config RTCARPLAY_OTA_COMPAT
    string "CPIO hardware compatibility identifier"
    depends on RTCARPLAY_OTA
    default "demo128-nand-carplay"
    help
      Must match the board field in the generated CPIO metadata. Use a distinct
      identifier for targets which must never install each other's updates.

config RTCARPLAY_WIFI_STA_MAINTENANCE
    bool "Wi-Fi station maintenance for system updates"
    default y
    depends on RTCARPLAY_OTA
    depends on AIC_WLAN_REALTEK || AIC_WLAN_AIC8800D40
    help
      Pause the CarPlay connection manager and use the WLAN station
      interface for maintenance. Restore the selected CarPlay connection
      policy when leaving station mode.

config RTCARPLAY_INTERNET_PROBE_PATH
    string "HTTP 204 connectivity probe path"
    default "/generate_204"
    depends on RTCARPLAY_INTERNET_SHARE

config RTCARPLAY_AUTO_START
    bool "Start the AirPlay receiver automatically after boot"
    depends on !RTCARPLAY_DEMO_LAUNCHER && !RTCARPLAY_AUTO_CONNECT
    default n
    help
      Start the receiver from main() instead of waiting for the
      carplay_start MSH command.  Enable after the manual bring-up has been
      verified on the board.

config RTCARPLAY_DIR
    string "rt-carplay repository path"
    default ""
    help
      Path to the rt-carplay checkout, relative to this directory or
      absolute.  An empty value uses the integration checkout's submodule in
      packages/third-party/rt-carplay; initialise it with
      "git submodule update --init packages/third-party/rt-carplay".
      Override only when building against a separate checkout.

config RTCARPLAY_WIRED_NETIF
    string "Wired Ethernet device name (two characters)"
    default "i0"
    help
      RT-Thread Ethernet device used for wired IPv6, n0 for the application
      CDC-NCM adapter or i0 for optional cherryusb-ipheth.

config RTCARPLAY_NATIVE_NCM
    bool "Use the application CDC-NCM adapter for wired CarPlay"
    depends on RTCARPLAY_USB_HOST && RT_USING_LWIP
    depends on !LPKG_CHERRYUSB_HOST_NCM
    depends on !LPKG_USING_CHERRYUSB_IPHETH
    default n
    help
      Bind the first Apple CDC-NCM control/data function rather than the
      vendor Apple Ethernet function. Set RTCARPLAY_WIRED_NETIF to n0.
      Disable LPKG_USING_CHERRYUSB_IPHETH: only this network function may
      be activated on the phone. Do not also enable the upstream singleton
      NCM driver. The maintained D213 GUI profile enables this adapter.

config RTCARPLAY_NCM_TRACE
    bool "Record bounded native NCM network header diagnostics"
    depends on RTCARPLAY_NATIVE_NCM
    default n
    help
      Record NS/NA targets, TCP endpoints and two other IPv6 headers per
      direction. carplay_usb net drains up to 24 metadata records. No media
      payloads are retained and USB completion callbacks do not print.

config RTCARPLAY_WIRED_PROTOCOL_TRACE
    bool "Observe wired iAP2 availability and startup fields"
    depends on RTCARPLAY_USB_HOST
    default n
    help
      Report bounded 0x4300 raw fields and outgoing identification, power
      and startup parameter lengths. No authentication keys are logged.

config RTCARPLAY_WIRED_REINVITE_DELAY_MS
    int "One wired startup invitation retry delay (ms, 0 disables)"
    default 10000
    range 0 60000
    depends on RTCARPLAY_USB_HOST
    help
      Application compatibility policy: send one additional StartSession
      after this wait if no AirPlay TCP connection has been accepted.
      Not an Apple protocol timeout. No periodic invitation loop is used.

config RTCARPLAY_SCREEN_WIDTH
    int "AirPlay logical display width"
    default 1024
    help
      Main Display width advertised in /info and used for phone HID input.
      The single-screen fusion launcher asks for 768x600 in FUSION (the left
      video viewport on a physical 1024x600 panel) and 1024x600 in FULLSCREEN,
      and maps physical touches through the latched video rectangle into that
      logical size. This value is only the fallback geometry for builds that
      start the receiver without the connection manager; keep it panel-sized.
      Changing this setting requires rebuilding and a new CarPlay session;
      runtime display settings recreate the session through its owner.

config RTCARPLAY_SCREEN_HEIGHT
    int "AirPlay logical display height"
    default 600

config RTCARPLAY_PANEL_WIDTH_MM
    int "Full panel active width in millimetres"
    range 1 1000
    default 200
    depends on RTCARPLAY_SINGLE_SCREEN_FUSION
    help
      Measure the LCD active area, excluding the bezel. 200 mm preserves the
      previous SDK estimate and is not panel calibration. The application
      scales this width to the selected phone viewport before /info.

config RTCARPLAY_PANEL_HEIGHT_MM
    int "Full panel active height in millimetres"
    range 1 1000
    default 120
    depends on RTCARPLAY_SINGLE_SCREEN_FUSION
    help
      Measure the LCD active area. 120 mm preserves the previous estimate;
      configure measured width and height for correct physical geometry.

config RTCARPLAY_ROTATION
    int "Display rotation (0, 90, 180 or 270)"
    default 0

config RTCARPLAY_VIDEO
    bool "Decode and display the AirPlay screen stream"
    default y
    depends on LPKG_MPP && AIC_MPP_H264_DEC_ENABLE && AIC_DE_DRV
    help
      Feed the Screen stream to the SDK MPP H.264 decoder (VE) and present
      the frames through the "aicfb" video layer.  This takes over the video
      layer and dims the UI layer while the receiver runs.

      Disable to keep the receiver headless (the application then only
      counts screen frames).  Requires the VE (video engine) and DE (display
      engine) drivers.

config RTCARPLAY_AUDIO
    bool "Play the AirPlay audio stream"
    default y
    depends on RT_USING_AUDIO
    help
      Decrypt the AirPlay audio DataStream (ChaCha20-Poly1305), advertise the
      available LPCM/AAC-LC/Opus output capabilities in /info and feed a
      dedicated jitter/decode/mix worker to RT-Thread sound0. Output uses
      48 kHz stereo with resampling and software gain/ducking. Compressed
      formats require LPKG_RT_CARPLAY_AUDIO_CODECS.

      Requires CONFIG_AIC_USING_AUDIO (which selects RT_USING_AUDIO) and the
      board's PA/speaker wiring.  Without this option the receiver is
      video-only and the controller starts no audio stream.

config RTCARPLAY_MICROPHONE
    bool "CarPlay microphone uplink (requires verified dmic0 hardware)"
    default n
    depends on RTCARPLAY_AUDIO && AIC_AUDIO_DMIC
    help
      Enable opt-in Siri/call input over AirPlay UDP using independent input
      keys. Captures 48 kHz stereo to preserve the shared codec clock and
      sends mono LPCM/Opus. Verify physical microphone wiring before enabling.
      This does not claim tuned acoustic echo cancellation.

config RTCARPLAY_MIC_AEC
    bool "Call acoustic echo cancellation (verify installed acoustic path)"
    default n
    depends on RTCARPLAY_MICROPHONE && LPKG_RT_CARPLAY_AUDIO_CODECS
    help
      SpeexDSP fixed-point AEC with queued DAC presentation and capture DMA
      timestamps. Runtime carplay_mic aec on/off and delay commands allow
      comparison and residual delay calibration. Verify installed acoustics;
      Host tests do not establish vehicle echo performance.

config RTCARPLAY_MIC_AEC_DELAY_MS
    int "Residual acoustic reference delay after queue compensation (ms)"
    default 0
    range 0 200
    depends on RTCARPLAY_MIC_AEC

# Board integration switches; portable SDK switches are defined by the SDK Kconfig.

config RTCARPLAY_TOUCH_PANEL
    bool "Forward the touch panel to CarPlay"
    default y
    depends on RT_USING_TOUCH
    help
      Open the RT-Thread CTP device selected by the display configuration
      (CONFIG_AIC_TOUCH_PANEL_NAME, "gt911" on demo128-nand-carplay), read
      its points on the panel interrupt and feed them to the CarPlay HID
      touch report.  Coordinates are scaled from the panel range to the
      display size. The SDK LVGL display port must reserve the exclusive
      touch device for this reader instead of opening it a second time.

      The HID report carries two contacts, so a third simultaneous finger
      is not forwarded.  Without this option only the carplay_touch shell
      command injects touches.

config RTCARPLAY_SDK_INTEGRATION
    bool
    default y
    select LPKG_USING_RT_CARPLAY

config LPKG_RT_CARPLAY_LUBANLITE_WIFI
    bool
    default y
    depends on AIC_WLAN_REALTEK || AIC8800_AP_VENDOR_IE

config LPKG_RT_CARPLAY_LUBANLITE_BT
    bool
    default y
    depends on LPKG_USING_ZEPHYR_BLUETOOTH && LPKG_BT_CLASSIC && LPKG_BT_RFCOMM

config LPKG_RT_CARPLAY_LUBANLITE_MFI
    bool
    default y if RTCARPLAY_MFI
    depends on AIC_I2C_DRV

config LPKG_RT_CARPLAY_LUBANLITE_USB
    bool
    default y if RTCARPLAY_USB_HOST
    depends on LPKG_CHERRYUSB_HOST

config RTCARPLAY_USB_HOST
    bool "Wired CarPlay USB host (CherryUSB)"
    default y
    depends on LPKG_CHERRYUSB_HOST
    help
      Add the carplay_usb shell command and compile the Luban-Lite CherryUSB
      host seam: hint the iPhone for its CarPlay USB configuration (Apple
      vendor request 0x52), select that configuration by descriptor, claim
      the USBMUX bulk interface and expose control/bulk transfers to the
      protocol core.  The board must enable a host controller, normally
      CONFIG_AIC_USING_USB1_HOST.

      This stage only proves enumeration, descriptor identification and the
      bulk pipe. An Ethernet host driver (for Apple ff/fd/01 use external
      cherryusb-ipheth) and lwIP IPv6 are
      required later for the wired AirPlay IP link.

config RTCARPLAY_BT
    bool "Bluetooth RFCOMM bring-up command"
    default y
    depends on LPKG_RT_CARPLAY_LUBANLITE_BT
    help
      Add the carplay_bt shell command: enable the Zephyr Classic host, open
      the iAP2 RFCOMM service with an SDP record, accept a phone connection
      and echo bytes.  This is the board bring-up path for the wireless iAP2
      transport; it does not start iAP2 or CarPlay by itself.

config SETTINGS
    bool
    help
      Zephyr settings API provided by the CarPlay DFS backend.

config RTCARPLAY_BT_PERSISTENCE
    bool "Save Bluetooth bonds in /data"
    depends on RTCARPLAY_BT && RT_USING_DFS
    default y
    select SETTINGS
    select LPKG_BT_SETTINGS
    help
      Restore Bluetooth link keys before publishing the iAP2 service.
      Uses platform/rtcp_bt_settings.c and the SDK
      settings-handler linker section. A full firmware flash erases /data.

config RTCARPLAY_IAP2
    bool "Wireless iAP2 session command"
    default y
    depends on RTCARPLAY_BT
    help
      Add the carplay_iap2 shell command: drive core/iap2/iap2_session over
      the RFCOMM transport (SDP iAP2 service, iAP2 link framing,
      IdentificationInformation, Wi-Fi configuration, CarPlay invite).  The
      receiver must be running (carplay_start).  Without an MFi 2.0C provider
      the session stops after identification and cannot reach
      CarPlayStartSession.

config RTCARPLAY_MFI
    bool "MFi 2.0C authentication coprocessor"
    default y
    depends on RTCARPLAY_IAP2 && AIC_I2C_DRV
    help
      Probe the MFi 2.0C-compatible authentication coprocessor at startup and
      use it for the iAP2 certificate/challenge exchange.  demo128-nand-carplay
      has the Apple 2.0C on i2c0 at 0x10 (0x11 also answers; board-verified in
      the CarPlay PoC).  The 0x6A device on the same bus is the vendor
      RJGT204, not the MFi coprocessor.  When the probe fails the session
      still runs, but stops after identification.

config RTCARPLAY_MFI_I2C_BUS
    string "I2C bus carrying the MFi coprocessor"
    default "i2c0"
    depends on RTCARPLAY_MFI

config RTCARPLAY_MFI_I2C_ADDR
    hex "MFi coprocessor I2C address"
    default 0x10
    depends on RTCARPLAY_MFI

endmenu
```
